## drivers/sensor/oemec/Kconfig
```kconfig
config PHSENSOR
    bool "Enable PHSENSOR"
    default y
    depends on DT_HAS_ZEPHYR_PHSENSOR_ENABLED
```

## dts/bindings/sensors/atlas,oemec.yaml
```yaml
# Copyright (c) 2025 Arribada Initiative CIC
# SPDX-License-Identifier: MIT
description: |
      Atlas OEM-EC control board 


compatible: "atlas,oemec"

include:
  - name: sensor-device.yaml
  - name: i2c-device.yaml

# TODO - add int-gpios/sqw, clock, etc.
```
